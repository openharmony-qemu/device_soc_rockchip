## rk3568_m/Kconfig.liteos_m.series
```kconfig
config SOC_SERIES_RK3568
    bool "Rockchip RK3568 Series"
    depends on PLATFORM_RK3568_M
    select ARCH_CORTEX_A55
    help
        Rockchip RK3568 SoC (4x Cortex-A55, GICv3, AArch64).

config SOC_COMPANY
    string
    default "rockchip" if PLATFORM_RK3568_M
```

## rk3568_m/Kconfig.liteos_m.soc
```kconfig
choice
    prompt "RK3568 series SoC"
    depends on SOC_SERIES_RK3568

config SOC_RK3568
    bool "SoC RK3568"
    default y

endchoice
```

## rk3588_m/Kconfig.liteos_m.series
```kconfig
config SOC_SERIES_RK3588
    bool "Rockchip RK3588 Series"
    depends on PLATFORM_RK3588_M
    select ARCH_CORTEX_A76
    help
        Rockchip RK3588 SoC (4x Cortex-A55 + 4x Cortex-A76, GICv3, AArch64).

config SOC_COMPANY
    string
    default "rockchip" if PLATFORM_RK3588_M
```

## rk3588_m/Kconfig.liteos_m.soc
```kconfig
choice
    prompt "RK3588 series SoC"
    depends on SOC_SERIES_RK3588

config SOC_RK3588
    bool "SoC RK3588"
    default y

endchoice
```
